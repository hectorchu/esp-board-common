## Kconfig
```kconfig
menu "Board Common"

    config BOARD_LANDSCAPE
        bool "Landscape orientation"
        default n
        help
            Rotate the display 90 degrees for landscape orientation.

            When enabled, LVGL sees swapped dimensions (V_RES x H_RES)
            and the board init code applies the appropriate flush callback
            rotation and touch coordinate transforms.

            The convenience macros BOARD_DISP_H_RES / BOARD_DISP_V_RES
            reflect the logical (post-rotation) dimensions.

    config BOARD_LOG_TO_FLASH
        bool "Boot log to flash"
        default n
        help
            Capture all ESP_LOGx output to a flash partition ("log_store").
            The previous boot's log is dumped to serial on startup.
            Requires a "log_store" data partition (subtype 0x42, 64KB+)
            in the partition table.

endmenu
```

## apps/camera_viewfinder/sdkconfig.defaults
```kconfig
# Camera viewfinder — shared settings for all boards

# Partition table
CONFIG_PARTITION_TABLE_CUSTOM=y
CONFIG_PARTITION_TABLE_CUSTOM_FILENAME="partitions.csv"
CONFIG_PARTITION_TABLE_FILENAME="partitions.csv"

# Task watchdog
CONFIG_ESP_TASK_WDT_TIMEOUT_S=10

# CSI camera (ESP32-P4 boards with OV5647)
CONFIG_CAMERA_OV5647=y
CONFIG_CAMERA_OV5647_MIPI_RAW8_800x1280_50FPS=y
CONFIG_ESP_VIDEO_ENABLE_ISP_PIPELINE_CONTROLLER=y
# Allow CSI driver to allocate its internal backup buffer for DMA safety
# CONFIG_ESP_VIDEO_DISABLE_MIPI_CSI_DRIVER_BACKUP_BUFFER is not set

# Disable task WDT — camera DQBUF blocks the idle task
CONFIG_ESP_TASK_WDT_EN=n
# FreeRTOS timer task needs more stack for camera/ISP
CONFIG_FREERTOS_TIMER_TASK_STACK_DEPTH=4096
```

## apps/touch_test/sdkconfig.defaults
```kconfig
# Touch test — minimal settings, no camera

# Partition table
CONFIG_PARTITION_TABLE_CUSTOM=y
CONFIG_PARTITION_TABLE_CUSTOM_FILENAME="partitions.csv"
CONFIG_PARTITION_TABLE_FILENAME="partitions.csv"

# Task watchdog — generous timeout for debugging
CONFIG_ESP_TASK_WDT_TIMEOUT_S=30

# LVGL fonts
CONFIG_LV_FONT_MONTSERRAT_24=y

# Multi-touch gesture recognition (pinch-to-zoom, two-finger rotation)
CONFIG_LV_USE_GESTURE_RECOGNITION=y
CONFIG_LV_USE_FLOAT=y
```

## boards/waveshare_p4_lcd43/sdkconfig.defaults
```kconfig
# Waveshare ESP32-P4 WiFi6 Touch LCD 4.3
CONFIG_IDF_TARGET="esp32p4"
CONFIG_ESPTOOLPY_FLASHMODE_QIO=y
CONFIG_ESPTOOLPY_FLASHSIZE_32MB=y
CONFIG_SPIRAM=y
CONFIG_SPIRAM_SPEED_200M=y
CONFIG_SPIRAM_XIP_FROM_PSRAM=y
CONFIG_COMPILER_OPTIMIZATION_PERF=y

# L2 cache sizing for MIPI-DSI frame buffers in PSRAM
CONFIG_CACHE_L2_CACHE_256KB=y
CONFIG_CACHE_L2_CACHE_LINE_128B=y

# FreeRTOS tick rate (needed for smooth LVGL rendering)
CONFIG_FREERTOS_HZ=1000

# Main task stack (MIPI-DSI init is deeper than SPI)
CONFIG_ESP_MAIN_TASK_STACK_SIZE=10240

# Required for some ESP32-P4 peripheral features
CONFIG_IDF_EXPERIMENTAL_FEATURES=y

# Disable power management (avoids clock gating issues with display)
CONFIG_PM_ENABLE=n

# Console output via USB-JTAG (visible on /dev/ttyACM0)
CONFIG_ESP_CONSOLE_USB_SERIAL_JTAG=y
```

## boards/waveshare_s3_lcd35b/sdkconfig.defaults
```kconfig
# Waveshare ESP32-S3 Touch LCD 3.5B
CONFIG_IDF_TARGET="esp32s3"
CONFIG_ESPTOOLPY_FLASHMODE_QIO=y
CONFIG_ESPTOOLPY_FLASHFREQ_80M=y
CONFIG_ESPTOOLPY_FLASHSIZE_16MB=y
CONFIG_SPIRAM=y
CONFIG_SPIRAM_BOOT_INIT=n
CONFIG_SPIRAM_MODE_OCT=n
CONFIG_SPIRAM_MODE_QUAD=y
CONFIG_SPIRAM_TYPE_AUTO=y
CONFIG_SPIRAM_SPEED_80M=y
CONFIG_ESP_DEFAULT_CPU_FREQ_MHZ_240=y
CONFIG_COMPILER_OPTIMIZATION_PERF=y
CONFIG_LV_CONF_SKIP=n

# SPI display requires ISR in IRAM so SPI transaction interrupts are not
# blocked by flash cache misses. Without this, display DMA from SPIRAM fails.
CONFIG_SPI_MASTER_ISR_IN_IRAM=y

# Disable power management: PM clock gating can scale down APB clock and
# gate SPI peripheral clocks, causing display transactions to fail.
CONFIG_PM_ENABLE=n

# Route console to USB-Serial/JTAG (the only USB connection on this board).
CONFIG_ESP_CONSOLE_USB_SERIAL_JTAG=n
```
